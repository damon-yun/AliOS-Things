## app/example/device_ctrl/Config.in
```kconfig
config AOS_APP_DEVICE_CTRL
    bool "device ctrl Sample"
    select AOS_COMP_NETMGR
    select AOS_COMP_CLI
    select AOS_COMP_CJSON
    select AOS_COMP_LINKKIT_SDK_C
    select APP_FEATURE_LINKKIT_MQTT
    help
        device ctrl sample

if AOS_APP_DEVICE_CTRL
# Configurations for app device ctrl
endif
```

## app/example/simple_mqtt/Config.in
```kconfig
config AOS_APP_SIMPLE_MQTT
    bool "mqtt Sample"
    select AOS_COMP_NETMGR
    select AOS_COMP_CLI
    select AOS_COMP_CJSON
    select AOS_COMP_LINKKIT_SDK_C
    select APP_FEATURE_LINKKIT_MQTT
    help
        blink sample

if AOS_APP_SIMPLE_MQTT
# Configurations for app blink
endif
```

## board/easyarm-rt1052/Config.in
```kconfig
config AOS_BOARD_EASYARM_RT1052
    bool "EASYARM_RT1052"
    select AOS_MCU_MIMXRT1052CVL5BIMPL
    select AOS_COMP_KERNEL_INIT
    help

if AOS_BOARD_EASYARM_RT1052
# Configurations for board easyarm-rt1052

# "BSP SUPPORT FEATURE"
config BSP_SUPPORT_UART
    bool
    default y

config BSP_SUPPORT_FLASH
    bool
    default y

endif
```

## platform/mcu/mimxrt1052cvl5b/Config.in
```kconfig
config AOS_MCU_MIMXRT1052CVL5BIMPL
    bool
    select AOS_ARCH_ARMV7M
    select AOS_COMP_RHINO
    select AOS_COMP_NEWLIB_STUB
    help
      driver & sdk for platform/mcu mimxrt1052cvl5bimpl

if AOS_MCU_MIMXRT1052CVL5BIMPL
# Configurations for mcu mimxrt1052cvl5bimpl
endif
```
